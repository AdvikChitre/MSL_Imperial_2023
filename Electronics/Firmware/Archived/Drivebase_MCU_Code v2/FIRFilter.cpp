// Adapted from code written by Phil Salmony: https://github.com/pms67/HadesFCS/tree/master/Filtering

#include "Arduino.h"
#include "FIRFilter.h"

// Setup filter coefficients generated by http://t-filter.engineerjs.com/. Low pass filter designed for 50Hz sampling frequency
static double FIRImpulseResponse[FIRFilterLength] = {
  -0.012815456742967593,
  -0.018876455462281224,
  -0.019262898146057847,
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  -0.018876455462281224,
  -0.012815456742967593
};

// Initialise filter
void FIRFilterInit(FIRFilter *fir) {

  // Clear filter buffer
  for (uint8_t i = 0; i < FIRFilterLength; i++) {
    fir->buf[i] = (float)0.0;
  }

  // Reset buffer index
  fir->bufIndex = (uint8_t)0;

  // Clear filter output
  fir->output = (float)0.0;
}

float FIRFilterUpdate(FIRFilter *fir, float input) {

  // Input the new value into the buffer
  fir->buf[fir->bufIndex] = input;

  // Increment the buffer index
  fir->bufIndex++;

  // If the buffer index is out of range, reset it
  if (fir->bufIndex == FIRFilterLength) {
    fir->bufIndex = 0;
  }

  fir->output = (float)0.0;

  uint8_t sumIndex = fir->bufIndex;

  for (uint8_t i = 0; i < FIRFilterLength; i++) {
    if (sumIndex > 0) {
      sumIndex--;
    } else {
      sumIndex = FIRFilterLength - 1;
    }

    // Multiply impulse response with shifted input sample and add it to output
    fir->output += FIRImpulseResponse[i] * fir->buf[sumIndex];
  }

  // Return filtered output
  return fir->output;
}